/dts-v1/;
/plugin/;
 
/ {
	fragment@0 {
	    target = <&amba_pl>;
	    __overlay__ {
        #address-cells = <1>;
        #size-cells = <1>;
       axiSlaveUCM: UCM@83C4C000 {
        reg = <0x83C4C000 0x1000>;
        compatible = "generic-uio";
        label = "UCM";
        linux,uio-name = "UCM";

      };
    };
  };
};
