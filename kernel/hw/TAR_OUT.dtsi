/dts-v1/;
/plugin/;
 
/ {
	fragment@0 {
	    target = <&amba_pl>;
	    __overlay__ {
        #address-cells = <1>;
        #size-cells = <1>;
       axiSlaveTAR_OUT: TAR_OUT@80032000 {
        reg = <0x80032000 0x1000>;
        compatible = "generic-uio";
        label = "TAR_OUT";
        linux,uio-name = "TAR_OUT";

      };
    };
  };
};
