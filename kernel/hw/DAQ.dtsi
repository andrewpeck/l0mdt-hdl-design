/dts-v1/;
/plugin/;
 
/ {
	fragment@0 {
	    target = <&amba_pl>;
	    __overlay__ {
        #address-cells = <1>;
        #size-cells = <1>;
       axiSlaveDAQ: DAQ@80008000 {
        reg = <0x80008000 0x1000>;
        compatible = "generic-uio";
        label = "DAQ";
        linux,uio-name = "DAQ";

      };
    };
  };
};
