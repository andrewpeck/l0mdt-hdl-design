/dts-v1/;
/plugin/;
 
/ {
	fragment@0 {
	    target = <&amba_pl>;
	    __overlay__ {
        #address-cells = <1>;
        #size-cells = <1>;
       axiSlaveHPS_OUT: HPS_OUT@80030000 {
        reg = <0x80030000 0x1000>;
        compatible = "generic-uio";
        label = "HPS_OUT";
        linux,uio-name = "HPS_OUT";

      };
    };
  };
};
