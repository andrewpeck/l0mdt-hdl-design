/dts-v1/;
/plugin/;
 
/ {
	fragment@0 {
	    target = <&amba_pl>;
	    __overlay__ {
        #address-cells = <1>;
        #size-cells = <1>;
       axiSlaveTAR_EXT: TAR_EXT@42000 {
        reg = <0x42000 0x1000>;
        compatible = "generic-uio";
        label = "TAR_EXT";
        linux,uio-name = "TAR_EXT";

      };
    };
  };
};
