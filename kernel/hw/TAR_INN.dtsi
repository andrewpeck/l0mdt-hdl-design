/dts-v1/;
/plugin/;
 
/ {
	fragment@0 {
	    target = <&amba_pl>;
	    __overlay__ {
        #address-cells = <1>;
        #size-cells = <1>;
       axiSlaveTAR_INN: TAR_INN@83C70000 {
        reg = <0x83C70000 0x1000>;
        compatible = "generic-uio";
        label = "TAR_INN";
        linux,uio-name = "TAR_INN";

      };
    };
  };
};
