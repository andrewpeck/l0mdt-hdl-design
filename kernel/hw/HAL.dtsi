/dts-v1/;
/plugin/;
 
/ {
	fragment@0 {
	    target = <&amba_pl>;
	    __overlay__ {
        #address-cells = <1>;
        #size-cells = <1>;
       axiSlaveHAL: HAL@80003000 {
        reg = <0x80003000 0x1000>;
        compatible = "generic-uio";
        label = "HAL";
        linux,uio-name = "HAL";

      };
    };
  };
};
