/dts-v1/;
/plugin/;
 
/ {
	fragment@0 {
	    target = <&amba_pl>;
	    __overlay__ {
        #address-cells = <1>;
        #size-cells = <1>;
       axiSlaveMTC: MTC@80005000 {
        reg = <0x80005000 0x1000>;
        compatible = "generic-uio";
        label = "MTC";
        linux,uio-name = "MTC";

      };
    };
  };
};
