/dts-v1/;
/plugin/;
 
/ {
	fragment@0 {
	    target = <&amba_pl>;
	    __overlay__ {
        #address-cells = <1>;
        #size-cells = <1>;
       axiSlaveMPL: MPL@83C4F000 {
        reg = <0x83C4F000 0x1000>;
        compatible = "generic-uio";
        label = "MPL";
        linux,uio-name = "MPL";

      };
    };
  };
};
