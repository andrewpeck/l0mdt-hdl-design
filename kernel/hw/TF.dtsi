/dts-v1/;
/plugin/;
 
/ {
	fragment@0 {
	    target = <&amba_pl>;
	    __overlay__ {
        #address-cells = <1>;
        #size-cells = <1>;
       axiSlaveTF: TF@80006000 {
        reg = <0x80006000 0x1000>;
        compatible = "generic-uio";
        label = "TF";
        linux,uio-name = "TF";

      };
    };
  };
};
